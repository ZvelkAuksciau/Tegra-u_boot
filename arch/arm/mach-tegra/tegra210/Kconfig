## arch/arm/mach-tegra/tegra210/Kconfig
```kconfig
if TEGRA210

choice
	prompt "Tegra210 board select"

config TARGET_E2220_1170
	bool "NVIDIA Tegra210 E2220-1170 board"
	help
	  E2220-1170 is a Tegra210 bringup board with onboard SoC, DRAM,
	  eMMC, SD card slot, HDMI, USB micro-B port, and sockets for various
	  expansion modules.

config TARGET_P2371_0000
	bool "NVIDIA Tegra210 P2371-0000 board"
	help
	  P2371-0000 is a P2581 or P2530 CPU board married to a P2595 I/O
	  board. The combination contains SoC, DRAM, eMMC, SD card slot,
	  HDMI, USB micro-B port, Ethernet via USB3, USB3 host port, SATA,
	  a GPIO expansion header, and an analog audio jack.

config TARGET_P2371_2180
	bool "NVIDIA Tegra210 P2371-2180 (Jetson TX1) board"
	help
	  P2371-2180 (Jetson TX1 developer kit) is a P2180 CPU board married
	  to a P2597 I/O board. The combination contains SoC, DRAM, eMMC, SD
	  card slot, HDMI, USB micro-B port, Ethernet via USB3, USB3 host
	  port, SATA, PCIe, and two GPIO expansion headers.

config TARGET_KMTI200_2180
	bool "NVIDIA Tegra210 KMTI200-2180 board"
	help
	  KMTI200-2180 is a P2180 CPU board married to custom KMTI board with
	  dual FPGA MIPI controllers and deserializer for Sony block cameras.
	  Support for RGB camera (Sony block camera) and LWIR camera (with
	  BT.656 interface. MicroSD, Ethernet, CAN bus via F105 processor,
	  2xMacXO2 FPGA's

config TARGET_P2571
	bool "NVIDIA Tegra210 P2571 base board"
	help
	  P2571 is a P2530 married to a P1963 I/O board

config TARGET_M3402_0000
	bool "NVIDIA Tegra210 M3402-0000 (OrcaRacer) board"
	help
	  OrcaRacer is a M3402 CPU board with a E3401 base board.

endchoice

config SYS_SOC
	default "tegra210"

source "board/nvidia/e2220-1170/Kconfig"
source "board/nvidia/p2371-0000/Kconfig"
source "board/nvidia/p2371-2180/Kconfig"
source "board/nvidia/kmti200-2180/Kconfig"
source "board/nvidia/p2571/Kconfig"
source "board/nvidia/m3402-0000/Kconfig"

endif
```

## board/nvidia/kmti200-2180/Kconfig
```kconfig
if TARGET_KMTI200_2180

config SYS_BOARD
	default "kmti200-2180"

config SYS_VENDOR
	default "nvidia"

config SYS_CONFIG_NAME
	default "kmti200-2180"

endif
```
